## Kconfig
```kconfig
mainmenu "ESP32-C6 Firmware Configuration"

menu "Architecture Configuration"
	rsource "arch/Kconfig"
endmenu

menu "Chip Configuration"
	rsource "chip/Kconfig"
endmenu

menu "Driver Configuration"
	rsource "drivers/Kconfig"
endmenu
```

## arch/Kconfig
```kconfig
config ARCH_RV32IMAC
	bool "RV32IMAC"
	default n
	help
		RISC-V 32bit CPU with IMAC extensions

if ARCH_RV32IMAC
	rsource "rv32imac/Kconfig"
endif
```

## chip/Kconfig
```kconfig
choice CHIP
	bool "Select Chip Model"
	default CHIP_ESP32C6

	config CHIP_ESP32C6
		bool "ESP32C6"
endchoice

if CHIP_ESP32C6
	rsource "esp32c6/Kconfig"
endif
```

## drivers/Kconfig
```kconfig
config DRV_UART
	bool "UART Driver"
	default n
	help
		Use UART Driver

if DRV_UART
	rsource "uart/Kconfig"
endif

config DRV_USB_SERIAL_JTAG
	bool "USB_SERIAL_JTAG Driver"
	default n
	help
		Use USB_SERIAL_JTAG Driver

if DRV_USB_SERIAL_JTAG
	rsource "usb_serial_jtag/Kconfig"
endif

config DRV_WDT
	bool "WDT Driver"
	default n
	help
		Use WDT Driver

if DRV_WDT
	rsource "wdt/Kconfig"
endif

config DRV_TIMG
	bool "TIMG Driver"
	default n
	help
		Use TIMG Driver

if DRV_TIMG
	rsource "timg/Kconfig"
endif
```

## lib/Kconfig
```kconfig
config LIB_PICOLIBC
	bool "Use Picolibc"
	default n
	help
		Use Picolibc

if LIB_PICOLIBC
	rsource "picolibc/Kconfig"
endif

config LIB_STUB
	bool "Use stub for libc binding"
	default y
	help
		Stub defines libc related essential functions ex. sbrk

if LIB_STUB
	rsource "stub/Kconfig"
endif
```

## lib/picolibc/Kconfig
```kconfig
config LIB_PICOLIBC_LIBC
	bool "Use libc"
	default y
	help
		Use libc module of picolibc from newlib

if LIB_PICOLIBC_LIBC
	rsource "libc/Kconfig"
endif

config LIB_PICOLIBC_LIBM
	bool "Use libm"
	default n
	help
		Use libm module of picolibc from newlib

if LIB_PICOLIBC_LIBM
	rsource "libm/Kconfig"
endif

config LIB_PICOLIBC_ATOMIC_UNGETC
	bool "Enable atomic_ungetc"
	default y
	help
		Enable atomic_ungetc

config LIB_PICOLIBC_ENABLE_MALLOC
	bool "Enable picolibc malloc"
	default y
	depends on LIB_PICOLIBC_LIBC_STDLIB
	help
		Compile picolibc's malloc/free/calloc/realloc. Requires an sbrk
		implementation from the application (see LIB_STUB).
```

## lib/picolibc/libc/Kconfig
```kconfig
config LIB_PICOLIBC_LIBC_ARGZ
	bool "libc argz"
	default n
	help
		Use argz from libc

config LIB_PICOLIBC_LIBC_CTYPE
	bool "libc ctype"
	default y
	help
		Use ctype from libc

config LIB_PICOLIBC_LIBC_ERRNO
	bool "libc errno"
	default y
	help
		Use errno from libc

config LIB_PICOLIBC_LIBC_LOCALE
	bool "libc locale"
	default y
	help
		Use locale from libc

config LIB_PICOLIBC_LIBC_MACHINE
	bool "libc machine"
	default n
	help
		Use machine from libc

config LIB_PICOLIBC_LIBC_MISC
	bool "libc misc"
	default y
	help
		Use misc from libc

config LIB_PICOLIBC_LIBC_SSP
	bool "libc ssp"
	default n
	help
		Use ssp from libc

config LIB_PICOLIBC_LIBC_STDIO
	bool "libc stdio"
	default y
	help
		Use stdio from libc

config LIB_PICOLIBC_LIBC_STDLIB
	bool "libc stdlib"
	default y
	help
		Use stdlib from libc

config LIB_PICOLIBC_LIBC_STRING
	bool "libc string"
	default y
	help
		Use string from libc

config LIB_PICOLIBC_LIBC_TIME
	bool "libc time"
	default y
	help
		Use time from libc
```

## lib/stub/Kconfig
```kconfig
config LIB_STUB_HEAP_SIZE
	int "Heap size (bytes) served by sbrk"
	default 32768
	help
		Upper bound on the heap region grown by sbrk. Starts at the
		linker symbol _end and is additionally capped by the stack top.
```
